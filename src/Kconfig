## src/arch/armv8/Kconfig
```kconfig
## SPDX-License-Identifier: Apache-2.0
## Copyright (c) Bao Project and Contributors. All rights reserved.

config ARCH_ARMV8
	bool

config ARCH
	default "armv8" if ARCH_ARMV8

config CPU
	string

config CPU_CORTEX_R52
	bool

config PLAT_HAS_GIC_CHOICE
	bool

choice
	prompt "GIC version"
	depends on PLAT_HAS_GIC_CHOICE

config GICV3
	bool "GICv3"

config GICV2
	bool "GICv2"

endchoice

config GIC_VERSION
	string
	default "GICV3" if GICV3
	default "GICV2" if GICV2

config MEM_PROT_MPU
	default y if ARCH_ARMV8 && ARCH_PROFILE = "armv8-r"
```

## src/arch/rh850/Kconfig
```kconfig
## SPDX-License-Identifier: Apache-2.0
## Copyright (c) Bao Project and Contributors. All rights reserved.

config ARCH_RH850
	bool

config ARCH
	default "rh850" if ARCH_RH850

config MEM_PROT_MPU
	default y if ARCH_RH850

config PHYS_IRQS_ONLY
	default y if ARCH_RH850
```

## src/arch/riscv/Kconfig
```kconfig
## SPDX-License-Identifier: Apache-2.0
## Copyright (c) Bao Project and Contributors. All rights reserved.

config ARCH_RISCV
	bool

config ARCH
	default "riscv" if ARCH_RISCV

config PLAT_HAS_IRQC_CHOICE
	bool

config PLAT_HAS_IPIC_CHOICE
	bool

choice
	prompt "Interrupt controller"
	depends on PLAT_HAS_IRQC_CHOICE

config IRQC_AIA
	bool "AIA"

config IRQC_APLIC
	bool "APLIC"

config IRQC_PLIC
	bool "PLIC"

endchoice

config IRQC
	string
	default "AIA" if IRQC_AIA
	default "APLIC" if IRQC_APLIC
	default "PLIC" if IRQC_PLIC

choice
	prompt "IPI controller"
	depends on PLAT_HAS_IPIC_CHOICE

config IPIC_SBI
	bool "SBI"

config IPIC_ACLINT
	bool "ACLINT"

endchoice

config IPIC
	string
	default "IPIC_SBI" if IPIC_SBI
	default "IPIC_ACLINT" if IPIC_ACLINT

config RISCV_PRIV_1_11
	bool

config RISCV_PRIV_VERSION
	string
	default "RISCV_PRIV_VERSION_1_11" if RISCV_PRIV_1_11
	default "RISCV_PRIV_VERSION_1_13" if ARCH_RISCV
```

## src/arch/tricore/Kconfig
```kconfig
## SPDX-License-Identifier: Apache-2.0
## Copyright (c) Bao Project and Contributors. All rights reserved.

config ARCH_TRICORE
	bool

config ARCH
	default "tricore" if ARCH_TRICORE
```

## src/core/Kconfig
```kconfig
## SPDX-License-Identifier: Apache-2.0
## Copyright (c) Bao Project and Contributors. All rights reserved.

menu "Core features"

config MMIO_SLAVE_SIDE_PROT
	bool "MMIO slave-side protection"
	depends on PLAT_HAS_MMIO_SLAVE_SIDE_PROT && MEM_PROT_MPU
	help
	  Enforce MMIO access control at the bus slave side instead of
	  through MPU entries on the master side.

config IPI_MAX_EVENTS
	int "Depth of the per-cpu message queue"
	default 253
	help
	  Depth of the per-cpu message queue
	  The default keeps the cpu interface within a single 4K page.

endmenu
```

## src/platform/agilex5/Kconfig
```kconfig
## SPDX-License-Identifier: Apache-2.0
## Copyright (c) Bao Project and Contributors. All rights reserved.

config PLATFORM
	default "agilex5" if PLAT_AGILEX5

config ARCH_SUB
	default "aarch64" if PLAT_AGILEX5

config ARCH_PROFILE
	default "armv8-a" if PLAT_AGILEX5

config CPU
	default "cortex-a55" if PLAT_AGILEX5

config GIC_VERSION
	default "GICV3" if PLAT_AGILEX5
```

## src/platform/agilex5/Kconfig.plat
```kconfig
## SPDX-License-Identifier: Apache-2.0
## Copyright (c) Bao Project and Contributors. All rights reserved.

config PLAT_AGILEX5
	bool "agilex5"
	select ARCH_ARMV8
```

## src/platform/atk-dlam62xb/Kconfig.plat
```kconfig
## SPDX-License-Identifier: Apache-2.0
## Copyright (c) Bao Project and Contributors. All rights reserved.

config PLAT_ATK_DLAM62XB
	bool "atk-dlam62xb"
	select ARCH_ARMV8
```

## src/platform/e3650/Kconfig
```kconfig
## SPDX-License-Identifier: Apache-2.0
## Copyright (c) Bao Project and Contributors. All rights reserved.

config PLATFORM
	default "e3650" if PLAT_E3650

config ARCH_SUB
	default "aarch32" if PLAT_E3650

config ARCH_PROFILE
	default "armv8-r" if PLAT_E3650

config GIC_VERSION
	default "GICV3" if PLAT_E3650
```

## src/platform/e3650/Kconfig.plat
```kconfig
## SPDX-License-Identifier: Apache-2.0
## Copyright (c) Bao Project and Contributors. All rights reserved.

config PLAT_E3650
	bool "e3650"
	select ARCH_ARMV8
	select CPU_CORTEX_R52
```

## src/platform/fvp-a-aarch32/Kconfig
```kconfig
## SPDX-License-Identifier: Apache-2.0
## Copyright (c) Bao Project and Contributors. All rights reserved.

config PLATFORM
	default "fvp-a-aarch32" if PLAT_FVP_A_AARCH32

config ARCH_SUB
	default "aarch32" if PLAT_FVP_A_AARCH32

config ARCH_PROFILE
	default "armv8-a" if PLAT_FVP_A_AARCH32

choice
	prompt "GIC version"
	depends on PLAT_FVP_A_AARCH32

config FVP_A_AARCH32_GICV3
	bool "GICv3"

config FVP_A_AARCH32_GICV2
	bool "GICv2"

endchoice

config GIC_VERSION
	default "GICV3" if FVP_A_AARCH32_GICV3
	default "GICV2" if FVP_A_AARCH32_GICV2
```

## src/platform/fvp-a/Kconfig
```kconfig
## SPDX-License-Identifier: Apache-2.0
## Copyright (c) Bao Project and Contributors. All rights reserved.

config PLATFORM
	default "fvp-a" if PLAT_FVP_A

config ARCH_SUB
	default "aarch64" if PLAT_FVP_A

config ARCH_PROFILE
	default "armv8-a" if PLAT_FVP_A
```

## src/platform/fvp-a/Kconfig.plat
```kconfig
## SPDX-License-Identifier: Apache-2.0
## Copyright (c) Bao Project and Contributors. All rights reserved.

config PLAT_FVP_A
	bool "fvp-a"
	select ARCH_ARMV8
```

## src/platform/fvp-r-aarch32/Kconfig
```kconfig
## SPDX-License-Identifier: Apache-2.0
## Copyright (c) Bao Project and Contributors. All rights reserved.

config PLATFORM
	default "fvp-r-aarch32" if PLAT_FVP_R_AARCH32

config ARCH_SUB
	default "aarch32" if PLAT_FVP_R_AARCH32

config ARCH_PROFILE
	default "armv8-r" if PLAT_FVP_R_AARCH32

config GIC_VERSION
	default "GICV3" if PLAT_FVP_R_AARCH32
```

## src/platform/fvp-r-aarch32/Kconfig.plat
```kconfig
## SPDX-License-Identifier: Apache-2.0
## Copyright (c) Bao Project and Contributors. All rights reserved.

config PLAT_FVP_R_AARCH32
	bool "fvp-r-aarch32"
	select ARCH_ARMV8
```

## src/platform/fvp-r/Kconfig
```kconfig
## SPDX-License-Identifier: Apache-2.0
## Copyright (c) Bao Project and Contributors. All rights reserved.

config PLATFORM
	default "fvp-r" if PLAT_FVP_R

config ARCH_SUB
	default "aarch64" if PLAT_FVP_R

config ARCH_PROFILE
	default "armv8-r" if PLAT_FVP_R

choice
	prompt "GIC version"
	depends on PLAT_FVP_R

config FVP_R_GICV3
	bool "GICv3"

config FVP_R_GICV2
	bool "GICv2"

endchoice

config GIC_VERSION
	default "GICV3" if FVP_R_GICV3
	default "GICV2" if FVP_R_GICV2
```

## src/platform/hikey960/Kconfig
```kconfig
## SPDX-License-Identifier: Apache-2.0
## Copyright (c) Bao Project and Contributors. All rights reserved.

config PLATFORM
	default "hikey960" if PLAT_HIKEY960

config ARCH_SUB
	default "aarch64" if PLAT_HIKEY960

config ARCH_PROFILE
	default "armv8-a" if PLAT_HIKEY960

config CPU
	default "cortex-a53" if PLAT_HIKEY960

config GIC_VERSION
	default "GICV2" if PLAT_HIKEY960
```

## src/platform/hikey960/Kconfig.plat
```kconfig
## SPDX-License-Identifier: Apache-2.0
## Copyright (c) Bao Project and Contributors. All rights reserved.

config PLAT_HIKEY960
	bool "hikey960"
```

## src/platform/imx8mn/Kconfig
```kconfig
## SPDX-License-Identifier: Apache-2.0
## Copyright (c) Bao Project and Contributors. All rights reserved.

config PLATFORM
	default "imx8mn" if PLAT_IMX8MN

config ARCH_SUB
	default "aarch64" if PLAT_IMX8MN

config ARCH_PROFILE
	default "armv8-a" if PLAT_IMX8MN

config CPU
	default "cortex-a53" if PLAT_IMX8MN

config GIC_VERSION
	default "GICV3" if PLAT_IMX8MN
```

## src/platform/imx8mn/Kconfig.plat
```kconfig
## SPDX-License-Identifier: Apache-2.0
## Copyright (c) Bao Project and Contributors. All rights reserved.

config PLAT_IMX8MN
	bool "imx8mn"
	select ARCH_ARMV8
```

## src/platform/imx8mp-verdin/Kconfig
```kconfig
## SPDX-License-Identifier: Apache-2.0
## Copyright (c) Bao Project and Contributors. All rights reserved.

config PLATFORM
	default "imx8mp-verdin" if PLAT_IMX8MP_VERDIN

config ARCH_SUB
	default "aarch64" if PLAT_IMX8MP_VERDIN

config ARCH_PROFILE
	default "armv8-a" if PLAT_IMX8MP_VERDIN

config CPU
	default "cortex-a53" if PLAT_IMX8MP_VERDIN

config GIC_VERSION
	default "GICV3" if PLAT_IMX8MP_VERDIN
```

## src/platform/imx8mp-verdin/Kconfig.plat
```kconfig
## SPDX-License-Identifier: Apache-2.0
## Copyright (c) Bao Project and Contributors. All rights reserved.

config PLAT_IMX8MP_VERDIN
	bool "imx8mp-verdin"
	select ARCH_ARMV8
```
