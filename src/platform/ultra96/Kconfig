## src/platform/ultra96/Kconfig
```kconfig
## SPDX-License-Identifier: Apache-2.0
## Copyright (c) Bao Project and Contributors. All rights reserved.

config PLATFORM
	default "ultra96" if PLAT_ULTRA96

config ARCH_SUB
	default "aarch64" if PLAT_ULTRA96

config ARCH_PROFILE
	default "armv8-a" if PLAT_ULTRA96

config CPU
	default "cortex-a53" if PLAT_ULTRA96

config GIC_VERSION
	default "GICV2" if PLAT_ULTRA96
```

## src/platform/ultra96/Kconfig.plat
```kconfig
## SPDX-License-Identifier: Apache-2.0
## Copyright (c) Bao Project and Contributors. All rights reserved.

config PLAT_ULTRA96
	bool "ultra96"
	select ARCH_ARMV8
```

## src/platform/zcu102/Kconfig
```kconfig
## SPDX-License-Identifier: Apache-2.0
## Copyright (c) Bao Project and Contributors. All rights reserved.

config PLATFORM
	default "zcu102" if PLAT_ZCU102

config ARCH_SUB
	default "aarch64" if PLAT_ZCU102

config ARCH_PROFILE
	default "armv8-a" if PLAT_ZCU102

config CPU
	default "cortex-a53" if PLAT_ZCU102

config GIC_VERSION
	default "GICV2" if PLAT_ZCU102
```

## src/platform/zcu102/Kconfig.plat
```kconfig
## SPDX-License-Identifier: Apache-2.0
## Copyright (c) Bao Project and Contributors. All rights reserved.

config PLAT_ZCU102
	bool "zcu102"
	select ARCH_ARMV8
```

## src/platform/zcu104/Kconfig
```kconfig
## SPDX-License-Identifier: Apache-2.0
## Copyright (c) Bao Project and Contributors. All rights reserved.

config PLATFORM
	default "zcu104" if PLAT_ZCU104

config ARCH_SUB
	default "aarch64" if PLAT_ZCU104

config ARCH_PROFILE
	default "armv8-a" if PLAT_ZCU104

config CPU
	default "cortex-a53" if PLAT_ZCU104

config GIC_VERSION
	default "GICV2" if PLAT_ZCU104
```
