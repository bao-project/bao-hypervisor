## src/platform/imx8qm/Kconfig
```kconfig
## SPDX-License-Identifier: Apache-2.0
## Copyright (c) Bao Project and Contributors. All rights reserved.

config PLATFORM
	default "imx8qm" if PLAT_IMX8QM

config ARCH_SUB
	default "aarch64" if PLAT_IMX8QM

config ARCH_PROFILE
	default "armv8-a" if PLAT_IMX8QM

config CPU
	default "cortex-a53" if PLAT_IMX8QM

config GIC_VERSION
	default "GICV3" if PLAT_IMX8QM
```

## src/platform/k3-com260/Kconfig
```kconfig
## SPDX-License-Identifier: Apache-2.0
## Copyright (c) Bao Project and Contributors. All rights reserved.

config PLATFORM
	default "k3-com260" if PLAT_K3_COM260

config ARCH_SUB
	default "riscv64" if PLAT_K3_COM260

config IRQC
	default "AIA" if PLAT_K3_COM260

config IPIC
	default "IPIC_SBI" if PLAT_K3_COM260
```

## src/platform/k3-com260/Kconfig.plat
```kconfig
## SPDX-License-Identifier: Apache-2.0
## Copyright (c) Bao Project and Contributors. All rights reserved.

config PLAT_K3_COM260
	bool "k3-com260"
```

## src/platform/mps3-an536/Kconfig
```kconfig
## SPDX-License-Identifier: Apache-2.0
## Copyright (c) Bao Project and Contributors. All rights reserved.

config PLATFORM
	default "mps3-an536" if PLAT_MPS3_AN536

config ARCH_SUB
	default "aarch32" if PLAT_MPS3_AN536

config ARCH_PROFILE
	default "armv8-r" if PLAT_MPS3_AN536
```

## src/platform/mps3-an536/Kconfig.plat
```kconfig
## SPDX-License-Identifier: Apache-2.0
## Copyright (c) Bao Project and Contributors. All rights reserved.

config PLAT_MPS3_AN536
	bool "mps3-an536"
	select ARCH_ARMV8
```

## src/platform/qemu-aarch64-virt/Kconfig
```kconfig
## SPDX-License-Identifier: Apache-2.0
## Copyright (c) Bao Project and Contributors. All rights reserved.

config PLATFORM
	default "qemu-aarch64-virt" if PLAT_QEMU_AARCH64_VIRT

config ARCH_SUB
	default "aarch64" if PLAT_QEMU_AARCH64_VIRT

config ARCH_PROFILE
	default "armv8-a" if PLAT_QEMU_AARCH64_VIRT

config CPU
	default "cortex-a53" if PLAT_QEMU_AARCH64_VIRT
```

## src/platform/qemu-aarch64-virt/Kconfig.plat
```kconfig
## SPDX-License-Identifier: Apache-2.0
## Copyright (c) Bao Project and Contributors. All rights reserved.

config PLAT_QEMU_AARCH64_VIRT
	bool "qemu-aarch64-virt"
```

## src/platform/qemu-riscv32-virt/Kconfig
```kconfig
## SPDX-License-Identifier: Apache-2.0
## Copyright (c) Bao Project and Contributors. All rights reserved.

config PLATFORM
	default "qemu-riscv32-virt" if PLAT_QEMU_RISCV32_VIRT

config ARCH_SUB
	default "riscv32" if PLAT_QEMU_RISCV32_VIRT

choice
	prompt "Interrupt controller"
	depends on PLAT_QEMU_RISCV32_VIRT

config QEMU_RISCV32_VIRT_IRQC_AIA
	bool "AIA"

config QEMU_RISCV32_VIRT_IRQC_PLIC
	bool "PLIC"

endchoice

config IRQC
	default "AIA" if QEMU_RISCV32_VIRT_IRQC_AIA
	default "PLIC" if QEMU_RISCV32_VIRT_IRQC_PLIC

choice
	prompt "IPI controller"
	depends on PLAT_QEMU_RISCV32_VIRT

config QEMU_RISCV32_VIRT_IPIC_SBI
	bool "SBI"

config QEMU_RISCV32_VIRT_IPIC_ACLINT
	bool "ACLINT"

endchoice

config IPIC
	default "IPIC_SBI" if QEMU_RISCV32_VIRT_IPIC_SBI
	default "IPIC_ACLINT" if QEMU_RISCV32_VIRT_IPIC_ACLINT
```

## src/platform/qemu-riscv32-virt/Kconfig.plat
```kconfig
## SPDX-License-Identifier: Apache-2.0
## Copyright (c) Bao Project and Contributors. All rights reserved.

config PLAT_QEMU_RISCV32_VIRT
	bool "qemu-riscv32-virt"
	select ARCH_RISCV
```

## src/platform/qemu-riscv64-virt/Kconfig
```kconfig
## SPDX-License-Identifier: Apache-2.0
## Copyright (c) Bao Project and Contributors. All rights reserved.

config PLATFORM
	default "qemu-riscv64-virt" if PLAT_QEMU_RISCV64_VIRT

config ARCH_SUB
	default "riscv64" if PLAT_QEMU_RISCV64_VIRT

choice
	prompt "Interrupt controller"
	depends on PLAT_QEMU_RISCV64_VIRT

config QEMU_RISCV64_VIRT_IRQC_AIA
	bool "AIA"

config QEMU_RISCV64_VIRT_IRQC_PLIC
	bool "PLIC"

endchoice

config IRQC
	default "AIA" if QEMU_RISCV64_VIRT_IRQC_AIA
	default "PLIC" if QEMU_RISCV64_VIRT_IRQC_PLIC

choice
	prompt "IPI controller"
	depends on PLAT_QEMU_RISCV64_VIRT

config QEMU_RISCV64_VIRT_IPIC_SBI
	bool "SBI"

config QEMU_RISCV64_VIRT_IPIC_ACLINT
	bool "ACLINT"

endchoice

config IPIC
	default "IPIC_SBI" if QEMU_RISCV64_VIRT_IPIC_SBI
	default "IPIC_ACLINT" if QEMU_RISCV64_VIRT_IPIC_ACLINT
```

## src/platform/qemu-riscv64-virt/Kconfig.plat
```kconfig
## SPDX-License-Identifier: Apache-2.0
## Copyright (c) Bao Project and Contributors. All rights reserved.

config PLAT_QEMU_RISCV64_VIRT
	bool "qemu-riscv64-virt"
	select ARCH_RISCV
```

## src/platform/rh850-u2a16/Kconfig
```kconfig
## SPDX-License-Identifier: Apache-2.0
## Copyright (c) Bao Project and Contributors. All rights reserved.

config PLATFORM
	default "rh850-u2a16" if PLAT_RH850_U2A16

config ARCH_PROFILE
	default "main" if PLAT_RH850_U2A16
```

## src/platform/rh850-u2a16/Kconfig.plat
```kconfig
## SPDX-License-Identifier: Apache-2.0
## Copyright (c) Bao Project and Contributors. All rights reserved.

config PLAT_RH850_U2A16
	bool "rh850-u2a16"
```

## src/platform/rpi4/Kconfig
```kconfig
## SPDX-License-Identifier: Apache-2.0
## Copyright (c) Bao Project and Contributors. All rights reserved.

config PLATFORM
	default "rpi4" if PLAT_RPI4

config ARCH_SUB
	default "aarch64" if PLAT_RPI4

config ARCH_PROFILE
	default "armv8-a" if PLAT_RPI4

config CPU
	default "cortex-a72" if PLAT_RPI4

config GIC_VERSION
	default "GICV2" if PLAT_RPI4
```

## src/platform/rpi4/Kconfig.plat
```kconfig
## SPDX-License-Identifier: Apache-2.0
## Copyright (c) Bao Project and Contributors. All rights reserved.

config PLAT_RPI4
	bool "rpi4"
```

## src/platform/s32g3/Kconfig
```kconfig
## SPDX-License-Identifier: Apache-2.0
## Copyright (c) Bao Project and Contributors. All rights reserved.

config PLATFORM
	default "s32g3" if PLAT_S32G3

config ARCH_SUB
	default "aarch64" if PLAT_S32G3

config ARCH_PROFILE
	default "armv8-a" if PLAT_S32G3

config CPU
	default "cortex-a53" if PLAT_S32G3

config GIC_VERSION
	default "GICV3" if PLAT_S32G3
```

## src/platform/s32g3/Kconfig.plat
```kconfig
## SPDX-License-Identifier: Apache-2.0
## Copyright (c) Bao Project and Contributors. All rights reserved.

config PLAT_S32G3
	bool "s32g3"
```

## src/platform/s32z270/Kconfig
```kconfig
## SPDX-License-Identifier: Apache-2.0
## Copyright (c) Bao Project and Contributors. All rights reserved.

config PLATFORM
	default "s32z270" if PLAT_S32Z270

config ARCH_SUB
	default "aarch32" if PLAT_S32Z270

config ARCH_PROFILE
	default "armv8-r" if PLAT_S32Z270

config GIC_VERSION
	default "GICV3" if PLAT_S32Z270


config MEM_NON_UNIFIED
	default y if PLAT_S32Z270

# Whether bit n of CPU_TCM_MASK is set: Kconfig has no bit operations, so the values of the 4-bit
# mask are enumerated by ranges (the platform defines generator rejects higher bits)
config S32Z270_CPU0_IN_TCM
	bool
	default y if CPU_TCM_MASK = 0x1 || CPU_TCM_MASK = 0x3 || CPU_TCM_MASK = 0x5 || CPU_TCM_MASK = 0x7 || \
		CPU_TCM_MASK = 0x9 || CPU_TCM_MASK = 0xB || CPU_TCM_MASK = 0xD || CPU_TCM_MASK = 0xF

config S32Z270_CPU1_IN_TCM
	bool
	default y if (CPU_TCM_MASK >= 0x2 && CPU_TCM_MASK <= 0x3) || (CPU_TCM_MASK >= 0x6 && CPU_TCM_MASK <= 0x7) || \
		(CPU_TCM_MASK >= 0xA && CPU_TCM_MASK <= 0xB) || (CPU_TCM_MASK >= 0xE && CPU_TCM_MASK <= 0xF)

config S32Z270_CPU2_IN_TCM
	bool
	default y if (CPU_TCM_MASK >= 0x4 && CPU_TCM_MASK <= 0x7) || (CPU_TCM_MASK >= 0xC && CPU_TCM_MASK <= 0xF)

config S32Z270_CPU3_IN_TCM
	bool
	default y if CPU_TCM_MASK >= 0x8 && CPU_TCM_MASK <= 0xF

choice
	prompt "TCM hosting the structure of cpu 0"
	depends on PLAT_S32Z270 && S32Z270_CPU0_IN_TCM
	default S32Z270_CPU0_HOME_ATCM
	help
	  Each core has an ATCM (64 KiB), a BTCM (16 KiB) and a CTCM
	  (16 KiB). The one chosen here hosts the structure of cpu 0 when
	  the cpu is in CPU_TCM_MASK; the other two are left entirely to the
	  guests.

config S32Z270_CPU0_HOME_ATCM
	bool "ATCM"

config S32Z270_CPU0_HOME_BTCM
	bool "BTCM"

config S32Z270_CPU0_HOME_CTCM
	bool "CTCM"

endchoice

config S32Z270_CPU0_HOME
	int
	depends on PLAT_S32Z270
	default 1 if S32Z270_CPU0_HOME_BTCM
	default 2 if S32Z270_CPU0_HOME_CTCM
	default 0

choice
	prompt "TCM hosting the structure of cpu 1"
	depends on PLAT_S32Z270 && S32Z270_CPU1_IN_TCM
	default S32Z270_CPU1_HOME_ATCM
	help
	  Each core has an ATCM (64 KiB), a BTCM (16 KiB) and a CTCM
	  (16 KiB). The one chosen here hosts the structure of cpu 1 when
	  the cpu is in CPU_TCM_MASK; the other two are left entirely to the
	  guests.

config S32Z270_CPU1_HOME_ATCM
	bool "ATCM"

config S32Z270_CPU1_HOME_BTCM
	bool "BTCM"

config S32Z270_CPU1_HOME_CTCM
	bool "CTCM"

endchoice

config S32Z270_CPU1_HOME
	int
	depends on PLAT_S32Z270
	default 1 if S32Z270_CPU1_HOME_BTCM
	default 2 if S32Z270_CPU1_HOME_CTCM
	default 0

choice
	prompt "TCM hosting the structure of cpu 2"
	depends on PLAT_S32Z270 && S32Z270_CPU2_IN_TCM
	default S32Z270_CPU2_HOME_ATCM
	help
	  Each core has an ATCM (64 KiB), a BTCM (16 KiB) and a CTCM
	  (16 KiB). The one chosen here hosts the structure of cpu 2 when
	  the cpu is in CPU_TCM_MASK; the other two are left entirely to the
	  guests.

config S32Z270_CPU2_HOME_ATCM
	bool "ATCM"

config S32Z270_CPU2_HOME_BTCM
	bool "BTCM"

config S32Z270_CPU2_HOME_CTCM
	bool "CTCM"

endchoice

config S32Z270_CPU2_HOME
	int
	depends on PLAT_S32Z270
	default 1 if S32Z270_CPU2_HOME_BTCM
	default 2 if S32Z270_CPU2_HOME_CTCM
	default 0

choice
	prompt "TCM hosting the structure of cpu 3"
	depends on PLAT_S32Z270 && S32Z270_CPU3_IN_TCM
	default S32Z270_CPU3_HOME_ATCM
	help
	  Each core has an ATCM (64 KiB), a BTCM (16 KiB) and a CTCM
	  (16 KiB). The one chosen here hosts the structure of cpu 3 when
	  the cpu is in CPU_TCM_MASK; the other two are left entirely to the
	  guests.

config S32Z270_CPU3_HOME_ATCM
	bool "ATCM"

config S32Z270_CPU3_HOME_BTCM
	bool "BTCM"

config S32Z270_CPU3_HOME_CTCM
	bool "CTCM"

endchoice

config S32Z270_CPU3_HOME
	int
	depends on PLAT_S32Z270
	default 1 if S32Z270_CPU3_HOME_BTCM
	default 2 if S32Z270_CPU3_HOME_CTCM
	default 0
```

## src/platform/s32z270/Kconfig.plat
```kconfig
## SPDX-License-Identifier: Apache-2.0
## Copyright (c) Bao Project and Contributors. All rights reserved.

config PLAT_S32Z270
	bool "s32z270"
	select ARCH_ARMV8
```

## src/platform/tc4dx/Kconfig
```kconfig
## SPDX-License-Identifier: Apache-2.0
## Copyright (c) Bao Project and Contributors. All rights reserved.

config PLATFORM
	default "tc4dx" if PLAT_TC4DX
```

## src/platform/tc4dx/Kconfig.plat
```kconfig
## SPDX-License-Identifier: Apache-2.0
## Copyright (c) Bao Project and Contributors. All rights reserved.

config PLAT_TC4DX
	bool "tc4dx"
```

## src/platform/tx2/Kconfig
```kconfig
## SPDX-License-Identifier: Apache-2.0
## Copyright (c) Bao Project and Contributors. All rights reserved.

config PLATFORM
	default "tx2" if PLAT_TX2

config ARCH_SUB
	default "aarch64" if PLAT_TX2

config ARCH_PROFILE
	default "armv8-a" if PLAT_TX2

config CPU
	default "cortex-a57" if PLAT_TX2

config GIC_VERSION
	default "GICV2" if PLAT_TX2
```

## src/platform/tx2/Kconfig.plat
```kconfig
## SPDX-License-Identifier: Apache-2.0
## Copyright (c) Bao Project and Contributors. All rights reserved.

config PLAT_TX2
	bool "tx2"
```
